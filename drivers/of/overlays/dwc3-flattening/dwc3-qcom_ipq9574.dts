// SPDX-License-Identifier: BSD-3-Clause
/*
 * Copyright (c) 2025 Qualcomm Innovation Center, Inc. All rights reserved.
 */
/dts-v1/;
/plugin/;

#include <dt-bindings/interrupt-controller/arm-gic.h>

/ {
	fragment@0 {
		target-path = "/soc@0/usb@8af8800";
		#address-cells = <1>;
		#size-cells = <1>;

		__overlay__ {
			compatible = "qcom,ipq9574-dwc3", "qcom,snps-dwc3";
			reg = <0x08a00000 0xd100>;
			interrupts-extended = <&intc GIC_SPI 140 IRQ_TYPE_LEVEL_HIGH>,
					      <&intc GIC_SPI 134 IRQ_TYPE_LEVEL_HIGH>;
			interrupt-names = "dwc_usb3",
					  "pwr_event";
			phys = <&usb_0_qusbphy>,
			       <&usb_0_qmpphy>;
			phy-names = "usb2-phy",
				    "usb3-phy";
		};
	};
};
