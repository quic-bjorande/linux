// SPDX-License-Identifier: BSD-3-Clause
/*
 * Copyright (c) 2025 Qualcomm Innovation Center, Inc. All rights reserved.
 */
/dts-v1/;
/plugin/;

#include <dt-bindings/interrupt-controller/arm-gic.h>

/ {
	fragment@0 {
		target-path = "/soc@0/usb@f92f8800";
		#address-cells = <1>;
		#size-cells = <1>;
		interrupt-parent = <&intc>;

		__overlay__ {
			compatible = "qcom,msm8994-dwc3", "qcom,snps-dwc3";
			reg = <0xf9200000 0xd000>;
			interrupts = <GIC_SPI 131 IRQ_TYPE_LEVEL_HIGH>,
				     <GIC_SPI 180 IRQ_TYPE_LEVEL_HIGH>,
				     <GIC_SPI 311 IRQ_TYPE_LEVEL_HIGH>,
				     <GIC_SPI 133 IRQ_TYPE_LEVEL_HIGH>,
				     <GIC_SPI 310 IRQ_TYPE_LEVEL_HIGH>;
			interrupt-names = "dwc_usb3",
					  "pwr_event",
					  "qusb2_phy",
					  "hs_phy_irq",
					  "ss_phy_irq";
		};
	};
};
