// SPDX-License-Identifier: BSD-3-Clause
/*
 * Copyright (c) 2025 Qualcomm Innovation Center, Inc. All rights reserved.
 */
/dts-v1/;
/plugin/;

#include <dt-bindings/interrupt-controller/arm-gic.h>

/ {
	fragment@0 {
		target-path = "/soc@0/usb@70f8800";
		#address-cells = <2>;
		#size-cells = <2>;
		interrupt-parent = <&intc>;

		__overlay__ {
			compatible = "qcom,ipq6018-dwc3", "qcom,snps-dwc3";
			reg = <0 0x07000000 0 0xd100>;
			interrupts = <GIC_SPI 99 IRQ_TYPE_LEVEL_HIGH>,
				     <GIC_SPI 128 IRQ_TYPE_LEVEL_HIGH>,
				     <GIC_SPI 130 IRQ_TYPE_LEVEL_HIGH>;
			interrupt-names = "dwc_usb3",
					  "pwr_event",
					  "qusb2_phy";
			phys = <&qusb_phy_1>;
			phy-names = "usb2-phy";
		};
	};

	fragment@1 {
		target-path = "/soc@0/usb@8af8800";
		#address-cells = <2>;
		#size-cells = <2>;
		interrupt-parent = <&intc>;

		__overlay__ {
			compatible = "qcom,ipq6018-dwc3", "qcom,snps-dwc3";
			reg = <0 0x08a00000 0 0xd100>;
			interrupts = <GIC_SPI 140 IRQ_TYPE_LEVEL_HIGH>,
				     <GIC_SPI 134 IRQ_TYPE_LEVEL_HIGH>,
				     <GIC_SPI 136 IRQ_TYPE_LEVEL_HIGH>,
				     <GIC_SPI 220 IRQ_TYPE_LEVEL_HIGH>;
			interrupt-names = "dwc_usb3",
					  "pwr_event",
					  "qusb2_phy",
					  "ss_phy_irq";
			phys = <&qusb_phy_0>,
			       <&ssphy_0>;
			phy-names = "usb2-phy",
				    "usb3-phy";
		};
	};
};
