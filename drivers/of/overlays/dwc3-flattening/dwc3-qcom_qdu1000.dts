// SPDX-License-Identifier: BSD-3-Clause
/*
 * Copyright (c) 2025 Qualcomm Innovation Center, Inc. All rights reserved.
 */
/dts-v1/;
/plugin/;

#include <dt-bindings/interrupt-controller/arm-gic.h>

/ {
	fragment@0 {
		target-path = "/soc@0/usb@a6f8800";
		#address-cells = <2>;
		#size-cells = <2>;

		__overlay__ {
			compatible = "qcom,qdu1000-dwc3", "qcom,snps-dwc3";
			reg = <0 0x0a600000 0 0xd100>;
			interrupts-extended = <&intc GIC_SPI 133 IRQ_TYPE_LEVEL_HIGH>,
					      <&intc GIC_SPI 130 IRQ_TYPE_LEVEL_HIGH>,
					      <&intc GIC_SPI 131 IRQ_TYPE_LEVEL_HIGH>,
					      <&pdc 8 IRQ_TYPE_EDGE_BOTH>,
					      <&pdc 9 IRQ_TYPE_EDGE_BOTH>,
					      <&pdc 6 IRQ_TYPE_LEVEL_HIGH>;
			interrupt-names = "dwc_usb3",
					  "pwr_event",
					  "hs_phy_irq",
					  "dp_hs_phy_irq",
					  "dm_hs_phy_irq",
					  "ss_phy_irq";
			iommus = <&apps_smmu 0xc0 0x0>;
			phys = <&usb_1_hsphy>,
			       <&usb_1_qmpphy>;
			phy-names = "usb2-phy",
				    "usb3-phy";
		};
	};
};
