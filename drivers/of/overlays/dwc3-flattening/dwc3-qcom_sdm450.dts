// SPDX-License-Identifier: BSD-3-Clause
/*
 * Copyright (c) 2025 Qualcomm Innovation Center, Inc. All rights reserved.
 */
/dts-v1/;
/plugin/;

#include <dt-bindings/interrupt-controller/arm-gic.h>

/ {
	fragment@0 {
		target-path = "/soc@0/usb@70f8800";
		#address-cells = <1>;
		#size-cells = <1>;
		interrupt-parent = <&intc>;

		__overlay__ {
			compatible = "qcom,msm8953-dwc3", "qcom,snps-dwc3";
			reg = <0x07000000 0xd000>;
			interrupts = <GIC_SPI 140 IRQ_TYPE_LEVEL_HIGH>,
				     <GIC_SPI 134 IRQ_TYPE_LEVEL_HIGH>,
				     <GIC_SPI 136 IRQ_TYPE_LEVEL_HIGH>,
				     <GIC_SPI 220 IRQ_TYPE_LEVEL_HIGH>;
			interrupt-names = "dwc_usb3",
					  "pwr_event",
					  "qusb2_phy",
					  "ss_phy_irq";
			phys = <&hsusb_phy>;
			phy-names = "usb2-phy";
		};
	};

};
