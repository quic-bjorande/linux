// SPDX-License-Identifier: BSD-3-Clause
/*
 * Copyright (c) 2025 Qualcomm Innovation Center, Inc. All rights reserved.
 */
/dts-v1/;
/plugin/;

#include <dt-bindings/interrupt-controller/arm-gic.h>

/ {
	fragment@0 {
		target-path = "/soc@0/usb@a6f8800";
		#address-cells = <2>;
		#size-cells = <2>;

		__overlay__ {
			compatible = "qcom,sa8775p-dwc3", "qcom,snps-dwc3";
			reg = <0 0x0a600000 0 0xe400>;
			interrupts-extended = <&intc GIC_SPI 292 IRQ_TYPE_LEVEL_HIGH>,
					      <&intc GIC_SPI 287 IRQ_TYPE_LEVEL_HIGH>,
					      <&intc GIC_SPI 261 IRQ_TYPE_LEVEL_HIGH>,
					      <&pdc 14 IRQ_TYPE_EDGE_BOTH>,
					      <&pdc 15 IRQ_TYPE_EDGE_BOTH>,
					      <&pdc 12 IRQ_TYPE_LEVEL_HIGH>;
			interrupt-names = "dwc_usb3",
					  "pwr_event",
					  "hs_phy_irq",
					  "dp_hs_phy_irq",
					  "dm_hs_phy_irq",
					  "ss_phy_irq";
			iommus = <&apps_smmu 0x80 0x0>;
			phys = <&usb_0_hsphy>,
			       <&usb_0_qmpphy>;
			phy-names = "usb2-phy",
				    "usb3-phy";
		};
	};

	fragment@1 {
		target-path = "/soc@0/usb@a8f8800";
		#address-cells = <2>;
		#size-cells = <2>;

		__overlay__ {
			compatible = "qcom,sa8775p-dwc3", "qcom,snps-dwc3";
			reg = <0 0x0a800000 0 0xe400>;
			interrupts-extended = <&intc GIC_SPI 349 IRQ_TYPE_LEVEL_HIGH>,
					      <&intc GIC_SPI 352 IRQ_TYPE_LEVEL_HIGH>,
					      <&intc GIC_SPI 351 IRQ_TYPE_LEVEL_HIGH>,
					      <&pdc 8 IRQ_TYPE_EDGE_BOTH>,
					      <&pdc 7 IRQ_TYPE_EDGE_BOTH>,
					      <&pdc 13 IRQ_TYPE_LEVEL_HIGH>;
			interrupt-names = "dwc_usb3",
					  "pwr_event",
					  "hs_phy_irq",
					  "dp_hs_phy_irq",
					  "dm_hs_phy_irq",
					  "ss_phy_irq";
			iommus = <&apps_smmu 0xa0 0x0>;
			phys = <&usb_1_hsphy>,
			       <&usb_1_qmpphy>;
			phy-names = "usb2-phy",
				    "usb3-phy";
		};
	};

	fragment@2 {
		target-path = "/soc@0/usb@a4f8800";
		#address-cells = <2>;
		#size-cells = <2>;

		__overlay__ {
			compatible = "qcom,sa8775p-dwc3", "qcom,snps-dwc3";
			reg = <0 0x0a400000 0 0xe400>;
			interrupts-extended = <&intc GIC_SPI 442 IRQ_TYPE_LEVEL_HIGH>,
					      <&intc GIC_SPI 444 IRQ_TYPE_LEVEL_HIGH>,
					      <&intc GIC_SPI 443 IRQ_TYPE_LEVEL_HIGH>,
					      <&pdc 10 IRQ_TYPE_EDGE_BOTH>,
					      <&pdc 9 IRQ_TYPE_EDGE_BOTH>;
			interrupt-names = "dwc_usb3",
					  "pwr_event",
					  "hs_phy_irq",
					  "dp_hs_phy_irq",
					  "dm_hs_phy_irq";
			iommus = <&apps_smmu 0x20 0x0>;
			phys = <&usb_2_hsphy>;
			phy-names = "usb2-phy";
		};
	};
};
