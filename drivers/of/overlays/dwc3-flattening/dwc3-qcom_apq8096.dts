// SPDX-License-Identifier: BSD-3-Clause
/*
 * Copyright (c) 2025 Qualcomm Innovation Center, Inc. All rights reserved.
 */
/dts-v1/;
/plugin/;

#include <dt-bindings/interrupt-controller/arm-gic.h>

/ {
	fragment@0 {
		target-path = "/soc@0/usb@6af8800";
		#address-cells = <1>;
		#size-cells = <1>;
		interrupt-parent = <&intc>;

		__overlay__ {
			compatible = "qcom,msm8996-dwc3", "qcom,snps-dwc3";
			reg = <0x06a00000 0xd000>;
			interrupts = <GIC_SPI 131 IRQ_TYPE_LEVEL_HIGH>,
				     <GIC_SPI 180 IRQ_TYPE_LEVEL_HIGH>,
				     <GIC_SPI 347 IRQ_TYPE_LEVEL_HIGH>,
				     <GIC_SPI 133 IRQ_TYPE_LEVEL_HIGH>,
				     <GIC_SPI 243 IRQ_TYPE_LEVEL_HIGH>;
			interrupt-names = "dwc_usb3",
					  "pwr_event",
					  "qusb2_phy",
					  "hs_phy_irq",
					  "ss_phy_irq";
			phys = <&hsusb_phy1>,
			       <&usb3phy>;
			phy-names = "usb2-phy",
				    "usb3-phy";
			extcon = <&usb2_id>;
		};
	};

	fragment@1 {
		target-path = "/soc@0/usb@76f8800";
		#address-cells = <1>;
		#size-cells = <1>;
		interrupt-parent = <&intc>;

		__overlay__ {
			compatible = "qcom,msm8996-dwc3", "qcom,snps-dwc3";
			reg = <0x07600000 0xd000>;
			interrupts = <GIC_SPI 138 IRQ_TYPE_LEVEL_HIGH>,
				     <GIC_SPI 140 IRQ_TYPE_LEVEL_HIGH>,
				     <GIC_SPI 352 IRQ_TYPE_LEVEL_HIGH>,
				     <GIC_SPI 139 IRQ_TYPE_LEVEL_HIGH>;
			interrupt-names = "dwc_usb3",
					  "pwr_event",
					  "qusb2_phy",
					  "hs_phy_irq";
			phys = <&hsusb_phy2>;
			phy-names = "usb2-phy";
			extcon = <&usb3_id>;
		};
	};
};
