// SPDX-License-Identifier: BSD-3-Clause
/*
 * Copyright (c) 2025 Qualcomm Innovation Center, Inc. All rights reserved.
 */
/dts-v1/;
/plugin/;

#include <dt-bindings/interrupt-controller/arm-gic.h>

/ {
	fragment@0 {
		target-path = "/soc@0/usb2@1e00000";
		#address-cells = <2>;
		#size-cells = <2>;

		__overlay__ {
			compatible = "qcom,ipq5424-dwc3", "qcom,snps-dwc3";
			reg = <0 0x01e00000 0 0xe400>;
			interrupts-extended = <&intc GIC_SPI 396 IRQ_TYPE_LEVEL_HIGH>,
					      <&intc GIC_SPI 395 IRQ_TYPE_LEVEL_HIGH>,
					      <&intc GIC_SPI 397 IRQ_TYPE_LEVEL_HIGH>,
					      <&intc GIC_SPI 387 IRQ_TYPE_LEVEL_HIGH>,
					      <&intc GIC_SPI 388 IRQ_TYPE_LEVEL_HIGH>;
			interrupt-names = "dwc_usb3",
					  "pwr_event",
					  "qusb2_phy",
					  "dm_hs_phy_irq",
					  "dp_hs_phy_irq";
			phys = <&qusb_phy_1>;
			phy-names = "usb2-phy";
		};
	};

	fragment@1 {
		target-path = "/soc@0/usb3@8a00000";
		#address-cells = <2>;
		#size-cells = <2>;

		__overlay__ {
			compatible = "qcom,ipq5424-dwc3", "qcom,snps-dwc3";
			reg = <0 0x08a00000 0 0xd100>;
			interrupts-extended = <&intc GIC_SPI 409 IRQ_TYPE_LEVEL_HIGH>,
					      <&intc GIC_SPI 412 IRQ_TYPE_LEVEL_HIGH>,
					      <&intc GIC_SPI 414 IRQ_TYPE_LEVEL_HIGH>,
					      <&intc GIC_SPI 423 IRQ_TYPE_LEVEL_HIGH>,
					      <&intc GIC_SPI 424 IRQ_TYPE_LEVEL_HIGH>;
			interrupt-names = "dwc_usb3",
					  "pwr_event",
					  "qusb2_phy",
					  "dm_hs_phy_irq",
					  "dp_hs_phy_irq";
			phys = <&qusb_phy_0>,
			       <&ssphy_0>;
			phy-names = "usb2-phy",
				    "usb3-phy";
		};
	};
};
