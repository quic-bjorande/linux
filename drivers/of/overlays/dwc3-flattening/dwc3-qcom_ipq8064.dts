// SPDX-License-Identifier: BSD-3-Clause
/*
 * Copyright (c) 2025 Qualcomm Innovation Center, Inc. All rights reserved.
 */
/dts-v1/;
/plugin/;

#include <dt-bindings/interrupt-controller/arm-gic.h>

/ {
	fragment@0 {
		target-path = "/soc/usb@100f8800";
		#address-cells = <1>;
		#size-cells = <1>;

		__overlay__ {
			compatible = "qcom,ipq8064-dwc3", "qcom,snps-dwc3";
			reg = <0x10000000 0x14d00>;
			phys = <&hs_phy_0>,
			       <&ss_phy_0>;
			phy-names = "usb2-phy",
				    "usb3-phy";
		};
	};

	fragment@1 {
		target-path = "/soc/usb@110f8800";
		#address-cells = <1>;
		#size-cells = <1>;

		__overlay__ {
			compatible = "qcom,ipq8064-dwc3", "qcom,snps-dwc3";
			reg = <0x11000000 0x14d00>;
			phys = <&hs_phy_1>,
			       <&ss_phy_1>;
			phy-names = "usb2-phy",
				    "usb3-phy";
		};
	};
};
